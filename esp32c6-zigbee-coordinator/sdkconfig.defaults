## esp32c6-zigbee-coordinator/sdkconfig.defaults
```kconfig
# ESP32-C6 Zigbee Coordinator sdkconfig defaults

# Target
CONFIG_IDF_TARGET="esp32c6"

# Zigbee stack - coordinator role
CONFIG_ZB_ENABLED=y
CONFIG_ZB_COORDINATOR_ROLE=y
CONFIG_ZB_ZCZR_ROLE=y

# Zigbee stack size and memory
CONFIG_ZB_STACK_SIZE=8192
CONFIG_ZB_HEAP_SIZE=20480

# IEEE 802.15.4 radio
CONFIG_IEEE802154_ENABLED=y

# UART for serial output / debug
CONFIG_ESP_CONSOLE_UART_DEFAULT=y
CONFIG_ESP_CONSOLE_UART_NUM=0
CONFIG_ESP_CONSOLE_UART_BAUDRATE=115200

# Logging
CONFIG_LOG_DEFAULT_LEVEL_INFO=y

# FreeRTOS
CONFIG_FREERTOS_HZ=1000

# Flash size (4MB typical for ESP32-C6)
CONFIG_ESPTOOLPY_FLASHSIZE_4MB=y
CONFIG_ESPTOOLPY_FLASHSIZE="4MB"

# Partition table
CONFIG_PARTITION_TABLE_SINGLE_APP=y
```
